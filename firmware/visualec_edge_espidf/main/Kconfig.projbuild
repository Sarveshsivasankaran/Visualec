## firmware/visualec_edge_espidf/main/Kconfig.projbuild
```kconfig
menu "Visualec edge configuration"

config VISUALEC_WIFI_SSID
    string "Wi-Fi SSID"
    default "Xx"

config VISUALEC_WIFI_PASSWORD
    string "Wi-Fi password"
    default "sarvesh@2643"

config VISUALEC_BACKEND_WS_URL
    string "Backend edge WebSocket URL"
    default "ws://10.57.98.1:8000/ws/edge"

config VISUALEC_DEVICE_TOKEN
    string "Edge device token"
    default "change-this-edge-token"

config VISUALEC_DEVICE_ID
    string "Device ID"
    default "visualec-esp32-s3"

config VISUALEC_FIRMWARE_VERSION
    string "Firmware version"
    default "visualec-edge-1.0.0"

config VISUALEC_MODEL_VERSION
    string "Model version"
    default "pedestrian-pico-bootstrap"

config VISUALEC_MODEL_SHA256
    string "Expected model SHA-256"
    default "bootstrap-component"

choice VISUALEC_MODEL_PROVIDER
    prompt "Inference model provider"
    default VISUALEC_USE_BOOTSTRAP_MODEL

config VISUALEC_USE_BOOTSTRAP_MODEL
    bool "Espressif pedestrian Pico bootstrap model"

config VISUALEC_USE_CUSTOM_MODEL
    bool "Verified Visualec-Pico artifact from VISUALEC_MODEL_ARTIFACT"

endchoice

endmenu
```

## firmware/visualec_edge_espidf/sdkconfig.defaults
```kconfig
CONFIG_IDF_TARGET="esp32s3"
CONFIG_ESPTOOLPY_FLASHMODE_QIO=y
CONFIG_ESPTOOLPY_FLASHSIZE_16MB=y
CONFIG_PARTITION_TABLE_CUSTOM=y
CONFIG_PARTITION_TABLE_CUSTOM_FILENAME="partitions.csv"
CONFIG_COMPILER_OPTIMIZATION_PERF=y
CONFIG_ESP_DEFAULT_CPU_FREQ_MHZ_240=y
CONFIG_SPIRAM=y
CONFIG_SPIRAM_MODE_OCT=y
CONFIG_SPIRAM_SPEED_80M=y
CONFIG_SPIRAM_XIP_FROM_PSRAM=y
CONFIG_ESP32S3_INSTRUCTION_CACHE_32KB=y
CONFIG_ESP32S3_DATA_CACHE_64KB=y
CONFIG_ESP32S3_DATA_CACHE_LINE_64B=y
CONFIG_FREERTOS_HZ=1000
CONFIG_MBEDTLS_CERTIFICATE_BUNDLE=y
CONFIG_PEDESTRIAN_DETECT_MODEL_IN_FLASH_PARTITION=y
CONFIG_ESP_WS_CLIENT_SEPARATE_TX_LOCK=y
CONFIG_ESP_WS_CLIENT_TX_LOCK_TIMEOUT_MS=3000
CONFIG_LWIP_TCP_WND_DEFAULT=57600
CONFIG_LWIP_TCP_SND_BUF_DEFAULT=57600
CONFIG_LWIP_TCP_RECVMBOX_SIZE=42
CONFIG_LWIP_TCPIP_RECVMBOX_SIZE=64
CONFIG_LWIP_TCP_SACK_OUT=y
CONFIG_ESP_WIFI_RX_BA_WIN=16
CONFIG_ESP_WIFI_DYNAMIC_RX_BUFFER_NUM=64
CONFIG_ESP_WIFI_DYNAMIC_TX_BUFFER_NUM=64
CONFIG_VISUALEC_WIFI_SSID="Xx"
CONFIG_VISUALEC_WIFI_PASSWORD="sarvesh@2643"
CONFIG_VISUALEC_BACKEND_WS_URL="ws://10.182.241.125:8000/ws/edge"
CONFIG_VISUALEC_DEVICE_TOKEN="replace-with-a-long-random-token"
CONFIG_ESP_CONSOLE_UART_DEFAULT=y
CONFIG_ESP_CONSOLE_SECONDARY_USB_SERIAL_JTAG=y
```
